## config/boards/shields/kb/Kconfig.defconfig
```kconfig
if SHIELD_KB_LEFT

# Name must be less than 16 characters long!
config ZMK_KEYBOARD_NAME
    default "Pappas tastatur"

endif

if SHIELD_KB_LEFT || SHIELD_KB_RIGHT

config ZMK_SPLIT
    default y

endif
```

## config/boards/shields/my_keyboard/Kconfig.shield
```kconfig
# No whitespace after the comma or in your part name!
config SHIELD_MY_KEYBOARD_LEFT
    def_bool $(shields_list_contains,my_keyboard_left)

# No whitespace after the comma or in your part name!
config SHIELD_MY_KEYBOARD_RIGHT
    def_bool $(shields_list_contains,my_keyboard_right)

config SHIELD_MY_KEYBOARD
    def_bool $(shields_list_contains,my_keyboard)

if SHIELD_MY_KEYBOARD

config ZMK_KEYBOARD_NAME
    default "My Keyboard"

if ZMK_SPLIT

config ZMK_SPLIT_BLE_ROLE_CENTRAL
    default y

endif # ZMK_SPLIT

endif # SHIELD_MY_KEYBOARD
```
